## config/boards/shields/enki42/Kconfig.shield
```kconfig
# Copyright (c) 2020 The ZMK Contributors
# SPDX-License-Identifier: MIT

config SHIELD_REV57LP_KB
	def_bool $(shields_list_contains,rev57lp_kb)

config SHIELD_REV57LP_DONGLE
	def_bool $(shields_list_contains,rev57lp_dongle)
```
